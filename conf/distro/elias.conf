## conf/distro/elias.conf
```bitbake
require conf/distro/poky.conf

DISTRO = "elias"
DISTRO_NAME = "Elias derivated from poky"

TARGET_VENODR = "-elias"

MAINTAINER = "Benoit Rapidel <benoit.rapidel+devs@exmachina.fr"

ELIAS_DEFAULT_DISTRO_FEATURES = "largefile"
DISTRO_FEATURES = "${DISTRO_FEATURES_DEFAULT} ${DISTRO_FEATURES_LIBC} ${ELIAS_DEFAULT_DISTRO_FEATURES}"
```

## conf/layer.conf
```bitbake
# We have a conf and classes directory, add to BBPATH
BBPATH .= ":${LAYERDIR}"

# We have recipes-* directories, add to BBFILES
BBFILES += "${LAYERDIR}/recipes-*/*/*.bb \
            ${LAYERDIR}/recipes-*/*/*.bbappend"

BBFILE_COLLECTIONS += "exm-core"
BBFILE_PATTERN_exm-core = "^${LAYERDIR}/"
BBFILE_PRIORITY_exm-core = "5"

LAYERVERSION_exm-core = "1"
```

## conf/machine/beaglebone.conf
```bitbake
PREFERRED_PROVIDER_virtual/kernel = "linux-mainline"
PREFERRED_VERSION_linux-mainline = "3.8%"

COMPATIBLE_MACHINE_beaglebone = "beaglebone"
```
