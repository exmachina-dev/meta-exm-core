/dts-v1/;
/plugin/;

/ {
    compatible = "ti,beaglebone", "ti,beaglebone-black";

    /* identification */
    part-number = "BB-ARMAZ";

    /* version */
    version = "00A0";

    /* state the resources this cape uses or prepare to get winged! */
    exclusive-use =
        /* the pin header P8 uses */
        "P8.10", /* SWITCH_0      */
        "P8.11", /* SWITCH_1      */
        "P8.13", /* FAN_0         */
        "P8.19", /* FAN_1         */
        /* the pin header P8 uses */
        "P9.39", /* TEMP_0        */
        "P9.40"; /* TEMP_1        */

    fragment@0 {
        target = <&am33xx_pinmux>;
        __overlay__ {
            armaz_pins: pinmux_armaz_pins{
                pinctrl-single,pins = <
                    0x024 0x07 // P8_13 = FAN_O     = GPIO0_23
                    0x020 0x07 // P8_19 = FAN_1     = GPIO0_22
                >;

            armaz_smitch_pins: pinmux_armaz_switch_pins{
                pinctrl-single,pins = <
                    0x098 0x37 // P8_10 = SWITCH_0          = GPIO2_04
                    0x034 0x37 // P8_11 = SWITCH_1          = GPIO1_13
                >;
            };

        };
    };

    fragment@1{
        target = <&ocp>;
        __overlay__{
            status = "okay";
            pinctrl-names = "default";
            pinctrl-0       = <&armaz_pins>;

            fan_0 {
                pin-names     = "Armaz:fan_0";
                gpios         = <&gpio0 23 0>;
            };
            fan_1 {
                pin-names     = "Armaz:fan_1";
                gpios         =<&gpio0 22 0>;
            };
        };
    };


    fragment@2 {
        target = <&ocp>;
        __overlay__ {
            #address-cells = <1>;
            #size-cells = <1>;

            thermistors {
                compatible = "bone-iio-helper";
                vsense-name  = "AIN0", "AIN1";
                vsense-scale = <100     100>;
                status = "okay";
            };

            gpio_keys {
                compatible = "gpio-keys";
                pinctrl-names = "default";
                pinctrl-0 = <&armaz_switch_pins>;
                #address-cells = <1>;
                #size-cells = <0>;

                switch_0 {
                    label = "Armas-switch-1";
                    debounce_interval = <50>;
                    linux,code = <1>;
                    gpios = <&gpio2 4 0x5>;
                    gpio-key,wakeup;
                };
                switch_1 {
                    label = "Armaz-switch-2";
                    debounce_interval = <50>;
                    linux,code = <2>;
                    gpios = <&gpio1 13 0x5>;
                    gpio-key,wakeup;
                };
            };
        };
    };
};
